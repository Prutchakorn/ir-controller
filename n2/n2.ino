#include <BossWiFi.h>
#include <MicroGear.h>
#include <ArduinoJson.h>

#ifndef UNIT_TEST
#include <Arduino.h>
#endif
#include <IRremoteESP8266.h>
#include <IRsend.h>

const uint16_t kIrLed = D2;  // ESP8266 GPIO pin to use. Recommended: 4 (D2).
IRsend irsend(kIrLed);

//BossWiFi wifi = BossWiFi("It's_a_trap", "18062000");
//BossWiFi wifi = BossWiFi("true_home2G_8xu1", "0824520932");
BossWiFi wifi = BossWiFi("MyDickIsBig", "0824520932Boss");
//BossWiFi wifi = BossWiFi("AndroidAP", "12345678");

#define APPID   "IRHomeController"
#define KEY     "jOXh9JkDCQ0HM9D"
#define SECRET  "UOxlaPdawNjghaQ8Ui5gRKfeQ"
#define ALIAS   "N2Alias"


int t = 0;
WiFiClient client;
MicroGear microgear(client);

char state = 0;
bool stateOutdated = 0;
char buff[16];

void onMsghandler(char *topic, uint8_t* msg, unsigned int msglen) {
  Serial.print("Incoming message --> ");
  msg[msglen] = '\0';
  Serial.println((char *)msg);

  DynamicJsonBuffer jsonBuffer;
  String input = (char *)msg;
  JsonObject& root = jsonBuffer.parseObject(input);
  if (!root.success()) {
    Serial.println("parseObject() failed");
    return;
  }
  bool isOn = root["power"];
  int temp = root["temp"];
  int windSpeedLevel = root["windspeed"];
  bool isSleepMode = root["sleepmode"];

  Serial.println(isOn);
  Serial.println(temp);
  Serial.println(windSpeedLevel);
  Serial.println(isSleepMode);
  sendSignal(isOn, temp, windSpeedLevel, isSleepMode);
}
void onFoundgear(char *attribute, uint8_t* msg, unsigned int msglen) {
  Serial.print("Found new member --> ");
  for (int i = 0; i < msglen; i++)
    Serial.print((char)msg[i]);
  Serial.println();
}
void onLostgear(char *attribute, uint8_t* msg, unsigned int msglen) {
  Serial.print("Lost member --> ");
  for (int i = 0; i < msglen; i++)
    Serial.print((char)msg[i]);
  Serial.println();
}
void onConnected(char *attribute, uint8_t* msg, unsigned int msglen) {
  Serial.println("Connected to NETPIE...");
  microgear.setAlias(ALIAS);

}


void setup() {

  microgear.on(MESSAGE, onMsghandler);
  microgear.on(PRESENT, onFoundgear);
  microgear.on(ABSENT, onLostgear);
  microgear.on(CONNECTED, onConnected);

  Serial.begin(115200);
  irsend.begin();

  pinMode(LED_BUILTIN, OUTPUT);
  if (wifi.connect()) {
    microgear.init(KEY, SECRET, ALIAS);
    microgear.connect(APPID);
  }
}

void loop() {
  if (microgear.connected()) {
    microgear.loop();
    if (t >= 1000) {

      t = 0;
    }
    else t += 100;
  } else {
    Serial.println("connection lost, reconnect...");
    if (t >= 5000) {
      microgear.connect(APPID);
      t = 0;
    }
    else t += 100;
  }
  delay(100);
}

uint16_t offdata[139] = {9030, 4476,  664, 1640,  666, 538,  664, 540,  666, 538,  642, 564,  642,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 564,  642};  // GREE
uint16_t ondata[139] = {9002, 4500,  642, 1670,  638, 562,  644, 566,  664, 1642,  640, 564,  640,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 1666,  664};  // GREE
uint16_t sixteen[139] = {9006, 4498,  666, 1646,  664, 534,  666, 540,  640, 1666,  640, 564,  642,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 540,  666};  // GREE
uint16_t seventeen[139] = {9000, 4500,  640, 1664,  644, 562,  642, 564,  640, 1666,  640, 564,  642,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 562,  642};  // GREE
uint16_t eighteen[139] = {9004, 4476,  640, 1668,  640, 562,  666, 540,  666, 1644,  638, 564,  640,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 540,  642};  // GREE
uint16_t nineteen[139] = {8982, 4500,  642, 1666,  640, 564,  642, 564,  640, 1664,  642, 564,  642,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 564,  642};  // GREE
uint16_t twenty[139] = {8982, 4500,  640, 1664,  642, 564,  642, 564,  642, 1666,  640, 564,  640,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 564,  640};  // GREE
uint16_t twentyone[139] = {9006, 4500,  638, 1670,  638, 564,  642, 564,  640, 1668,  638, 566,  640,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 1668,  640};  // GREE
uint16_t twentytwo[139] = {9006, 4498,  642, 1668,  638, 564,  642, 564,  642, 1668,  640, 566,  640,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 1666,  642};  // GREE
uint16_t twentythree[139] = {9000, 4474,  640, 1668,  638, 564,  642, 564,  640, 1668,  640, 564,  640,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 1668,  638};  // GREE
uint16_t twentyfour[139] = {9006, 4474,  640, 1668,  638, 566,  640, 564,  666, 1642,  666, 538,  664,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 1668,  640};  // GREE
uint16_t twentyfive[139] = {8982, 4498,  642, 1666,  642, 562,  642, 564,  666, 1642,  666, 538,  642,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 1666,  642};  // GREE
uint16_t twentysix[139] = {8978, 4500,  642, 1664,  668, 540,  642, 562,  642, 1670,  662, 540,  642,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 1642,  640};  // GREE
uint16_t twentyseven[139] = {8982, 4500,  642, 1662,  642, 564,  642, 564,  640, 1668,  638, 566,  666,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 1668,  640};  // GREE
uint16_t twentyeight[139] = {9004, 4500,  662, 1644,  666, 540,  666, 540,  640, 1668,  638, 564,  666,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 1666,  640};  // GREE
uint16_t twentynine[139] = {9004, 4498,  642, 1668,  638, 564,  642, 564,  640, 1668,  640, 566,  640,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 562,  642};  // GREE
uint16_t thirty[139] = {8980, 4500,  640, 1666,  640, 564,  642, 564,  640, 1668,  640, 564,  642,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 562,  642};  // GREE

bool isTurnOn = false;

void sendSignal(bool isOn, int temp, int windSpeedLevel, bool isSleepMode) {
  Serial.println("Sending...");

  if (!isTurnOn) {
    Serial.print("ON");
    irsend.sendRaw(ondata, 139, 38); // Send a raw data capture at 38kHz.
    isTurnOn = true;
  } else {
    if (!isOn) {
      Serial.print("OFF");
      irsend.sendRaw(offdata, 139, 38); // Send a raw data capture at 38kHz.
      isTurnOn = false;
    } else {
      switch (temp) {
        case 16:
          irsend.sendRaw(sixteen, 139, 38); // Send a raw data capture at 38kHz.
          break;
        case 17:
          irsend.sendRaw(seventeen, 139, 38); // Send a raw data capture at 38kHz.
          break;
        case 18:
          irsend.sendRaw(eighteen, 139, 38); // Send a raw data capture at 38kHz.
          break;
        case 19:
          irsend.sendRaw(nineteen, 139, 38); // Send a raw data capture at 38kHz.
          break;
        case 20:
          irsend.sendRaw(twenty, 139, 38); // Send a raw data capture at 38kHz.
          break;
        case 21:
          irsend.sendRaw(twentyone, 139, 38); // Send a raw data capture at 38kHz.
          break;
        case 22:
          irsend.sendRaw(twentytwo, 139, 38); // Send a raw data capture at 38kHz.
          break;
        case 23:
          irsend.sendRaw(twentythree, 139, 38); // Send a raw data capture at 38kHz.
          break;
        case 24:
          irsend.sendRaw(twentyfour, 139, 38);
          break;
        case 25:
          irsend.sendRaw(twentyfive, 139, 38); // Send a raw data capture at 38kHz.
          break;
        case 26:
          irsend.sendRaw(twentysix, 139, 38); // Send a raw data capture at 38kHz.
          break;
        case 27:
          irsend.sendRaw(twentyseven, 139, 38); // Send a raw data capture at 38kHz.
          break;
        case 28:
          irsend.sendRaw(twentyeight, 139, 38); // Send a raw data capture at 38kHz.
          break;
        case 29:
          irsend.sendRaw(twentynine, 139, 38); // Send a raw data capture at 38kHz.
          break;
        case 30:
          irsend.sendRaw(thirty, 139, 38); // Send a raw data capture at 38kHz.
          break;
      }
    }
  }
  delay(2000);
}




